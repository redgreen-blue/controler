## main/Kconfig.projbuild
```kconfig
menu "WM8741 Control"

    config I2C_MASTER_SCL
        int "I2C SCL GPIO"
        default 22
        range 0 39

    config I2C_MASTER_SDA
        int "I2C SDA GPIO"
        default 21
        range 0 39

    config I2C_MASTER_FREQUENCY
        int "I2C frequency (Hz)"
        default 100000
        range 1 400000

    config MCLK_SEL_GPIO
        int "MCLK select GPIO"
        help
            GPIO used to switch the MCLK source crystal. Output high (1)
            selects the 22 MHz crystal, output low (0) selects 24 MHz.
        default 10
        range 0 39

    config MCLK_SEL_DEFAULT
        int "MCLK select default (1=22MHz, 0=24MHz)"
        help
            Level applied to the MCLK select GPIO at boot.
            0 selects 24 MHz, 1 selects 22 MHz.
        default 0
        range 0 1

    config ESP_WIFI_SSID
        string "Wi-Fi SSID"
        default "myssid"

    config ESP_WIFI_PASSWORD
        string "Wi-Fi Password"
        default "mypassword"

    config ESP_WIFI_MAX_RETRY
        int "Wi-Fi max retry"
        default 5

    config UDP_DISCOVER_PORT
        int "UDP discover port"
        default 8888
        range 1024 65535

    config TCP_SERVER_PORT
        int "TCP server port"
        default 8889
        range 1024 65535

endmenu
```
